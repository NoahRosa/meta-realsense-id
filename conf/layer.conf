## conf/layer.conf
```bitbake
# We have a conf and classes directory, add to BBPATH
BBPATH .= ":${LAYERDIR}"

# We have recipes-* directories, add to BBFILES
BBFILES += "${LAYERDIR}/recipes-*/*/*.bb \
            ${LAYERDIR}/recipes-*/*/*.bbappend"

BBFILE_COLLECTIONS += "meta-realsense-id"
BBFILE_PATTERN_meta-realsense-id = "^${LAYERDIR}/"
BBFILE_PRIORITY_meta-realsense-id = "6"

LAYERDEPENDS_meta-realsense-id = "core"
LAYERSERIES_COMPAT_meta-realsense-id = "dunfell"
```
